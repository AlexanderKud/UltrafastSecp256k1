## tests/esp32p4_audit/sdkconfig.defaults
```kconfig
# sdkconfig.defaults for esp32p4_audit
# Use the large single-app partition table (1500K app) to accommodate
# the full audit binary (~1.07 MB).
CONFIG_PARTITION_TABLE_SINGLE_APP_LARGE=y
```
